## Documentation/devicetree/bindings/iio/dac/ad5820.txt
```
Analog Devices AD5820 DAC device driver

Required properties:
- compatible: Must be "adi,ad5820"
- reg: I2C address for the device
- #io-channel-cells: Must be 0, for details see
  Documentation/devicetree/bindings/iio/iio-bindings.txt

Example:

		dac@0c {
			compatible = "adi,ad5820";
			reg = <0x0c>;

			#io-channel-cells = <0>;
		};
```

## Documentation/devicetree/bindings/media/dac-camera-autofocus.txt
```
Bindings for digital-analog-converter based camera autofocus

Required Properties:

- compatible: Must contain "dac-camera-autofocus"
- io-channels: Must be a iio specifier to DAC channel
- lens-control: Must be a phandle to the camera chip,
  which is affected by the autofocus

Example:

autofocus: dac-camera-autofocus {
	compatible = "dac-camera-autofocus";
	io-channels = <&ad5820>;
	lens-control = <&cam1>;
};
```

## Documentation/devicetree/bindings/media/i2c/toshiba,et8ek8.txt
```
Toshiba ET8EK8 sensor

Toshiba ET8EK8 is an image sensor used in the Nokia N900.

Additional information about video interfaces in DT can be found in
Documentation/devicetree/bindings/media/video-interfaces.txt .

Mandatory properties
--------------------

- compatible: "toshiba,et8ek8"
- reg: I2C address (0x3e, or an alternative address)
- vana-supply: Analogue voltage supply (VANA), typically 2.8 volts (sensor
  dependent).
- clocks: External clock to the sensor
- clock-frequency: Frequency of the external clock to the sensor

Optional properties
-------------------

- reset-gpios: XSHUTDOWN GPIO


Endpoint node mandatory properties
----------------------------------

- clock-lanes: <0>
- data-lanes: <1>
- remote-endpoint: A phandle to the bus receiver's endpoint node.

Example
-------

&i2c2 {
	clock-frequency = <400000>;

	cam1: camera@3e {
		compatible = "toshiba,et8ek8";
		reg = <0x3e>;

		vana-supply = <&vaux4>;

		clocks = <&isp 0>;
		clock-frequency = <9600000>;

		reset-gpio = <&gpio4 6 GPIO_ACTIVE_HIGH>; /* 102 */

		port {
			cam1_1: endpoint {
				clock-lanes = <0>;
				data-lanes = <1>;
				remote-endpoint = <&isp_csi>;
			};
		};
	};
};
```

## Documentation/devicetree/bindings/media/video-bus-switch.txt
```
Video Bus Switch Binding
========================

This is a binding for a gpio controlled switch for camera interfaces. Such a
device is used on some embedded devices to connect two cameras to the same
interface of a image signal processor.

Required properties
===================

compatible	: must contain "video-bus-switch"
switch-gpios	: GPIO specifier for the gpio, which can toggle the
		  selected camera. The GPIO should be configured, so
		  that a disabled GPIO means, that the first port is
		  selected.

Required Port nodes
===================

More documentation on these bindings is available in
video-interfaces.txt in the same directory.

reg		: The interface:
		  0 - port for image signal processor
		  1 - port for first camera sensor
		  2 - port for second camera sensor

Example
=======

video-bus-switch {
	compatible = "video-bus-switch"
	switch-gpios = <&gpio1 1 GPIO_ACTIVE_HIGH>;

	ports {
		#address-cells = <1>;
		#size-cells = <0>;

		port@0 {
			reg = <0>;

			csi_switch_in: endpoint {
				remote-endpoint = <&csi_isp>;
			};
		};

		port@1 {
			reg = <1>;

			csi_switch_out1: endpoint {
				remote-endpoint = <&csi_cam1>;
			};
		};

		port@2 {
			reg = <2>;

			csi_switch_out2: endpoint {
				remote-endpoint = <&csi_cam2>;
			};
		};
	};
};
```

## Documentation/devicetree/bindings/serial/omap_serial.txt
```
OMAP UART controller

Required properties:
- compatible : should be "ti,omap2-uart" for OMAP2 controllers
- compatible : should be "ti,omap3-uart" for OMAP3 controllers
- compatible : should be "ti,omap4-uart" for OMAP4 controllers
- compatible : should be "ti+brcm,omap3-uart,bcm2048" for bcm2048
	       bluetooth connected to OMAP3 serial
- ti,hwmods : Must be "uart<n>", n being the instance number (1-based)

Optional properties:
- clock-frequency : frequency of the clock input to the UART

Required properties for ti+brcm,omap3-uart,bcm2048:
- reset-gpios : gpio for reset pin
- host-wakeup-gpios : gpio for host wakeup
- bluetooth-wakeup-gpios : gpio for bluetooth wakeup
```

## drivers/dsp/bridge/Kconfig
```kconfig
#
# DSP Bridge Driver Support
#

menuconfig MPU_BRIDGE
	tristate "DSP Bridge driver"
	default n
	help
	  DSP/BIOS Bridge is designed for platforms that contain a GPP and
	  one or more attached DSPs.  The GPP is considered the master or
	  "host" processor, and the attached DSPs are processing resources
	  that can be utilized by applications and drivers running on the GPP.

config BRIDGE_DVFS
	bool "Enable Bridge Dynamic Voltage and Frequency Scaling (DVFS)"
	depends on MPU_BRIDGE && OMAP_PM_SRF
	default n
	help
	  DVFS allows DSP Bridge to initiate the operating point change to
	  scale the chip voltage and frequency in order to match the
	  performance and power consumption to the current processing
	  requirements.

config BRIDGE_MEMPOOL_SIZE
	hex "Physical memory pool size (Byte)"
	depends on MPU_BRIDGE
	default 0x600000
	help
	  Allocate specified size of memory at booting time to avoid allocation
	  failure under heavy memory fragmentation after some use time.

config BRIDGE_DEBUG
	bool "DSP Bridge Debug Support"
	depends on MPU_BRIDGE
	help
	  Say Y to enable Bridge debugging capabilities
```

## drivers/gpu/drm-tungsten/Kconfig
```kconfig
#
# DRM device configuration from Tungsten Graphics
#
# This driver provides support for the
# Direct Rendering Infrastructure (DRI) in XFree86 4.1.0 and higher.
#
# The driver is the Tungsten alternative of the original DRM driver.
#

menuconfig DRM_TUNGSTEN
	tristate "Direct Rendering Manager (Tungsten - XFree86 4.1.0 and higher DRI support)"
	help
	  Kernel-level support for the Direct Rendering Infrastructure (DRI)
	  introduced in XFree86 4.0. If you say Y here, you need to select
	  the module that's right for your graphics card from the list below.
	  These modules provide support for synchronization, security, and
	  DMA transfers. Please see <http://dri.sourceforge.net/> for more
	  details.  You should also select and configure AGP
	  (/dev/agpgart) support.

config DRM_TUNGSTEN_PVR2D
	tristate "PVR2D kernel helper"
	depends on DRM_TUNGSTEN && PVR
	help
	  Choose this option if you want to give DRI access to your card
	  handled by the Imagination PowerVR framework. If M is selected,
	  the module will be called pvr2d.

if DRM_TUNGSTEN && (AGP || AGP=n) && PCI && !EMULATED_CMPXCHG

config DRM_TUNGSTEN_TDFX
	tristate "3dfx Banshee/Voodoo3+"
	help
	  Choose this option if you have a 3dfx Banshee or Voodoo3 (or later),
	  graphics card.  If M is selected, the module will be called tdfx.

config DRM_TUNGSTEN_R128
	tristate "ATI Rage 128"
	help
	  Choose this option if you have an ATI Rage 128 graphics card.  If M
	  is selected, the module will be called r128.  AGP support for
	  this card is strongly suggested (unless you have a PCI version).

config DRM_TUNGSTEN_RADEON
	tristate "ATI Radeon"
	help
	  Choose this option if you have an ATI Radeon graphics card.  There
	  are both PCI and AGP versions.  You don't need to choose this to
	  run the Radeon in plain VGA mode.

	  If M is selected, the module will be called radeon.

config DRM_TUNGSTEN_I810
	tristate "Intel I810"
	depends on AGP && AGP_INTEL
	help
	  Choose this option if you have an Intel I810 graphics card.  If M is
	  selected, the module will be called i810.  AGP support is required
	  for this driver to work.

config DRM_TUNGSTEN_I915
	tristate "i915 driver"
	depends on AGP && AGP_INTEL
	help
	  Choose this option if you have a system that has Intel 830M, 845G,
	  852GM, 855GM 865G or 915G integrated graphics.  If M is selected, the
	  module will be called i915.  AGP support is required for this driver
	  to work. This driver is used by the Intel driver in X.org 6.8 and
	  XFree86 4.4 and above. If unsure, build this and i830 as modules and
	  the X server will load the correct one.

config DRM_TUNGSTEN_MGA
	tristate "Matrox g200/g400"
	help
	  Choose this option if you have a Matrox G200, G400 or G450 graphics
	  card.  If M is selected, the module will be called mga.  AGP
	  support is required for this driver to work.

config DRM_TUNGSTEN_SIS
	tristate "SiS video cards"
	depends on AGP
	help
	  Choose this option if you have a SiS 630 or compatible video
          chipset. If M is selected the module will be called sis. AGP
          support is required for this driver to work.

config DRM_TUNGSTEN_VIA
	tristate "Via unichrome video cards"
	help
	  Choose this option if you have a Via unichrome or compatible video
	  chipset. If M is selected the module will be called via.

config DRM_TUNGSTEN_SAVAGE
	tristate "Savage video cards"
	help
	  Choose this option if you have a Savage3D/4/SuperSavage/Pro/Twister
	  chipset. If M is selected the module will be called savage.

config DRM_TUNGSTEN_FFB
	tristate "Creator/Creator3D direct rendering"
	help
	  Choose this option to include the Creator/Creator3D direct rendering
	  driver. If M is selected the module will be called ffb.

config DRM_TUNGSTEN_MACH64
	tristate "MACH64 Rage Pro video card"
	help
	  Choose this option if you have a Mach64 Rage Pro chipset.
	  If M is selected the module will be called mach64.

config DRM_TUNGSTEN_NV
	tristate "Nvidia video card (NV driver)"
	help
	  Choose this option if you have a Nvidia chipset and want to use the
	  original nv driver. If M is selected the module will be called nv.

config DRM_TUNGSTEN_NOUVEAU
	tristate "Nvidia video card (Nouveau driver)"
	help
	  Choose this option if you have a Nvidia chipset and want to use the
	  nouveau driver. If M is selected the module will be called nouveau.

config DRM_TUNGSTEN_XGI
	tristate "XGI video card"
	help
	  Choose this option if you have a XGI chipset. If M is selected the
	  module will be called xgi.

endif # DRM_TUNGSTEN && (AGP || AGP=n) && PCI && !EMULATED_CMPXCHG
```

## drivers/gpu/pvr/Kconfig
```kconfig
menuconfig PVR
	tristate "PowerVR Services"
	depends on OMAP2_DSS

if PVR

choice
	prompt "Build type"
	default PVR_RELEASE
config PVR_RELEASE
	bool "Release"
config PVR_DEBUG
	bool "Debug"
config PVR_TIMING
	bool "Timing"
endchoice

config PVR_EXAMPLES
	tristate "Example code"
	default n

endif
```

## drivers/hsi/clients/Kconfig
```kconfig
#
# HSI clients configuration
#

comment "HSI clients"

config NOKIA_MODEM
	tristate "Nokia Modem"
	depends on HSI && SSI_PROTOCOL
	help
	Say Y here if you want to add support for the modem on Nokia
	N900 (Nokia RX-51) hardware.

	If unsure, say N.

config SSI_PROTOCOL
	tristate "SSI protocol"
	depends on HSI && PHONET && OMAP_SSI
	help
	If you say Y here, you will enable the SSI protocol aka McSAAB.

	If unsure, say N.

config HSI_CHAR
	tristate "HSI/SSI character driver"
	depends on HSI
	---help---
	  If you say Y here, you will enable the HSI/SSI character driver.
	  This driver provides a simple character device interface for
	  serial communication with the cellular modem over HSI/SSI bus.

config HSI_CMT_SPEECH
        tristate "HSI/SSI CMT speech driver"
        depends on HSI && SSI_PROTOCOL
        ---help---
	  If you say Y here, you will enable the HSI CMT speech driver.
	  This driver implements a character device interface for transferring
	  speech data frames over HSI. This driver is used in e.g. Nokia N900.

	  If unsure, say Y, or else you will not be able to make voice calls.
```

## drivers/hsi/controllers/Kconfig
```kconfig
#
# HSI controllers configuration
#
comment "HSI controllers"

config OMAP_SSI
	tristate "OMAP SSI hardware driver"
	depends on (ARCH_OMAP2 || ARCH_OMAP3) && HSI
	default n
	---help---
	  If you say Y here, you will enable the OMAP SSI hardware driver.

	  If unsure, say N.

if OMAP_SSI

config OMAP_SSI_CONFIG
	boolean
	default y

endif # OMAP_SSI
```

## drivers/input/lirc/Kconfig
```kconfig
#
# LIRC driver(s) configuration
#
menuconfig INPUT_LIRC
	bool "Linux Infrared Remote Control IR receiver/transmitter drivers"
	help
	  Say Y here, and all supported Linux Infrared Remote Control IR and
	  RF receiver and transmitter drivers will be displayed. When paired
	  with a remote control and the lirc daemon, the receiver drivers
	  allow control of your Linux system via remote control.

if INPUT_LIRC

config LIRC_DEV
	tristate "LIRC device loadable module support"
	help
	  LIRC device loadable module support, required for most LIRC drivers

config LIRC_RX51
	tristate "RX51 CIR transmitter"
	depends on LIRC_DEV
	depends on ARCH_OMAP
	help
	  Driver for Nokia RX51 CIR circuitry

endif
```

## drivers/media/i2c/smia/Kconfig
```kconfig
config VIDEO_SMIAREGS
	tristate "Generic SMIA I2C register access and register list helper"
	depends on I2C
	---help---
	  This allows writing and reading SMIA image sensors' I2C registers
	  easily.

	  Also a few helper functions are provided to work with binary
	  register lists.

config VIDEO_ET8EK8
	tristate "ET8EK8 camera sensor support"
	depends on I2C && VIDEO_V4L2 && VIDEO_V4L2_SUBDEV_API
	select VIDEO_SMIAREGS
	---help---
	  This is a driver for the Toshiba ET8EK8 5 MP camera sensor.
	  It is used for example in Nokia N900 (RX-51).
```

## drivers/misc/cmt-speech/Kconfig
```kconfig
#
# OMAP SSI kernel configuration
#

config SSI_CMT_SPEECH
	tristate "CMT speech driver"
	depends on OMAP_SSI
	---help---
	  If you say Y here, you will enable the CMT speech driver.
	  This driver provides a simple interface for the user space speech
	  protocol implementation to communicate with the cellular engine over
	  the SSI bus.

	  If unsure, say Y, or else you will not be able to make voice calls.

config SSI_CMT_SPEECH_DEBUG
	bool "Debug CMT speech driver"
	depends on SSI_CMT_SPEECH && DEBUG_KERNEL
	default n
	---help---
	  Enable the debug information in the CMT speech driver. Be warned
	  that it can be quite noisy.

          If unsure, say N.
```

## drivers/misc/cmt/Kconfig
```kconfig
#
# CMT
#
config CMT
	tristate "Enable CMT support"
	---help---
	  If you say Y here, you will enable CMT support.

	  If unsure, say Y, or else you will not be able to use the CMT.
```

## drivers/misc/mcsaab/Kconfig
```kconfig
#
# SSI protocol kernel configuration
#
config SSI_MCSAAB_IMP
	tristate "Enable SSI McSAAB improved protocol"
	depends on OMAP_SSI && PHONET
	---help---
	  If you say Y here, you will enable the SSI McSAAB improved protocol.

	  If unsure, say Y, or else you will not be able to connect to the CMT.
```

## drivers/misc/ssi-char/Kconfig
```kconfig
#
# OMAP SSI kernel configuration
#

config SSI_CHAR
	tristate "SSI character driver"
	depends on OMAP_SSI
	---help---
	  If you say Y here, you will enable the CMT character driver.
	  This driver provides a simple character device interface for
	  serial communication with the cellular modem over the SSI bus.

config SSI_CHAR_DEBUG
	bool "Debug CMT character driver"
	depends on SSI_CHAR && DEBUG_KERNEL
	default n
	---help---
	  Enable the debug information in the CMT character driver.
```

## drivers/misc/ssi/Kconfig
```kconfig
#
# OMAP SSI HW kernel configuration
#
config OMAP_SSI
	tristate "OMAP SSI hardware driver"
	depends on ARCH_OMAP
	default n
	---help---
	  If you say Y here, you will enable the OMAP SSI hardware driver.

	  If unsure, say N.
```

## drivers/video/omap2/Kconfig
```kconfig
source "drivers/video/omap2/dss/Kconfig"
source "drivers/video/omap2/displays/Kconfig"
source "drivers/video/omap2/omapfb/Kconfig"
```
