## drivers/video/omap2/displays/Kconfig
```kconfig
menu "OMAP2/3 Display Device Drivers"
        depends on OMAP2_DSS

config PANEL_NEVADA
        tristate "Nevada Panel"
        help
          Nevada LCD

config CTRL_ZONDA
        tristate "Zonda ctrl"
        depends on OMAP2_DSS_DSI
        help
          Zonda Ctrl

config PANEL_TAAL
	tristate "Taal Panel"
	depends on OMAP2_DSS_DSI
	help
	  Taal panel with integrated controller

config PANEL_ACX565AKM
        tristate "ACX565AKM LCD Panel"
        depends on OMAP2_DSS_SDI
	select BACKLIGHT_CLASS_DEVICE
        help
          LCD Panel used in Rover

config PANEL_GENERIC
        tristate "Generic Panel"
        help
	  Generic panel driver.
	  Used for DVI output for Beagle and OMAP3 SDP.

config PANEL_SAMSUNG_LTE430WQ_F0C
        tristate "Samsung LTE430WQ-F0C LCD Panel"
        depends on OMAP2_DSS
        help
          LCD Panel used on Overo Palo43

config PANEL_SHARP_LS037V7DW01
        tristate "Sharp LS037V7DW01 LCD Panel"
        depends on OMAP2_DSS
        help
          LCD Panel used in TI's SDP3430 and EVM boards
endmenu
```

## security/aegis/Kconfig
```kconfig
#
# Maemo Aegis security configuration
#


config SECURITY_AEGIS
        bool "Maemo Aegis Security Framework"
        default n
        help
          This selects the Maemo Aegis Security Framework.
          Aegis contains access control and integrity validation
          components.
          If you are unsure how to answer this question, answer N.

source security/aegis/validator/Kconfig
source security/aegis/restok/Kconfig
source security/aegis/creds/Kconfig
source security/aegis/credp/Kconfig
```

## security/aegis/credp/Kconfig
```kconfig
config SECURITY_AEGIS_CREDP
	bool "Credentials policy manager"
	depends on SECURITY_CREDENTIALS_POLICY
	depends on SECURITY_AEGIS
	default n
	help
	  This selects the Credentials Policy Manager module.
	  This is part of Maemo Aegis Security framework.
	  If you are unsure how to answer this question, answer N.
```

## security/aegis/creds/Kconfig
```kconfig
config SECURITY_AEGIS_CREDS
	tristate "Credentials retrieval"
	depends on SECURITY_AEGIS
	default n
	help
	  This selects the Credentials Retrieval module, which
	  provides the task credentials information for the
	  user space applications.
	  This is part of Maemo Aegis Security framework.
	  If you are unsure how to answer this question, answer N.
```

## security/aegis/restok/Kconfig
```kconfig
config SECURITY_AEGIS_RESTOK
	tristate "Resource Token database manager"
	depends on SECURITY_AEGIS
	select SECURITYFS
	default n
	help
	  This selects the Resource Token database manager. This is
	  part of Maemo Aegis security framework.
	  If you are unsure how to answer this question, answer N.
```
